## firmware/main/Kconfig.projbuild
```kconfig
menu "focOS Configuration"

    menu "E-Paper Display Pinout (WeAct Studio 3.7\" UC8253C)"
        config FOCOS_EPD_SDA_GPIO
            int "SDA (Serial Data / MOSI) GPIO"
            default 23 if IDF_TARGET_ESP32
            default 11 if IDF_TARGET_ESP32S3
            range 0 48
            help
                GPIO pin connected to the display SDA (MOSI) pin.

        config FOCOS_EPD_SCL_GPIO
            int "SCL (Serial Clock / SCK) GPIO"
            default 18 if IDF_TARGET_ESP32
            default 12 if IDF_TARGET_ESP32S3
            range 0 48
            help
                GPIO pin connected to the display SCL (Clock) pin.

        config FOCOS_EPD_CS_GPIO
            int "CS (Chip Select) GPIO"
            default 5 if IDF_TARGET_ESP32
            default 10 if IDF_TARGET_ESP32S3
            range 0 48
            help
                GPIO pin connected to the display CS pin.

        config FOCOS_EPD_DC_GPIO
            int "D/C (Data / Command) GPIO"
            default 19 if IDF_TARGET_ESP32
            default 13 if IDF_TARGET_ESP32S3
            range 0 48
            help
                GPIO pin connected to the display D/C pin (avoids GPIO 17 for PSRAM safety).

        config FOCOS_EPD_RES_GPIO
            int "RES (Reset) GPIO"
            default 21 if IDF_TARGET_ESP32
            default 14 if IDF_TARGET_ESP32S3
            range 0 48
            help
                GPIO pin connected to the display RES (Reset) pin (avoids GPIO 16 for PSRAM safety).

        config FOCOS_EPD_BUSY_GPIO
            int "BUSY Status GPIO"
            default 4 if IDF_TARGET_ESP32
            default 9 if IDF_TARGET_ESP32S3
            range 0 48
            help
                GPIO pin connected to the display BUSY pin.
    endmenu

    menu "Rotary Encoder Pinout (Knob)"
        config FOCOS_ENC_CLK_GPIO
            int "Encoder Phase A (CLK) GPIO"
            default 32 if IDF_TARGET_ESP32
            default 4 if IDF_TARGET_ESP32S3
            range 0 48
            help
                GPIO connected to Encoder CLK (Channel A).

        config FOCOS_ENC_DT_GPIO
            int "Encoder Phase B (DT) GPIO"
            default 33 if IDF_TARGET_ESP32
            default 5 if IDF_TARGET_ESP32S3
            range 0 48
            help
                GPIO connected to Encoder DT (Channel B).

        config FOCOS_ENC_SW_GPIO
            int "Encoder Switch / Button (SW) GPIO"
            default 25 if IDF_TARGET_ESP32
            default 6 if IDF_TARGET_ESP32S3
            range 0 48
            help
                GPIO connected to Encoder push button.
    endmenu

    menu "System Identity & Telemetry"
        config FOCOS_DEVICE_NAME
            string "Default Bluetooth & Network Device Name"
            default "focOS-Desk"
            help
                Name advertised by focOS during BLE onboarding and mDNS.

        config FOCOS_TIMEZONE_POSIX
            string "Default POSIX Timezone String"
            default "<-03>3"
            help
                Default POSIX timezone (<-03>3 is America/Sao_Paulo / Brasilia without DST).
    endmenu

endmenu
```

## firmware/sdkconfig.defaults
```kconfig
# Target Architecture
CONFIG_IDF_TARGET="esp32"

# Flash Size (4MB standard)
CONFIG_ESPTOOLPY_FLASHSIZE_4MB=y
CONFIG_ESPTOOLPY_FLASHSIZE="4MB"

# Custom Partition Table
CONFIG_PARTITION_TABLE_CUSTOM=y
CONFIG_PARTITION_TABLE_CUSTOM_FILENAME="partitions.csv"
CONFIG_PARTITION_TABLE_FILENAME="partitions.csv"

# FreeRTOS 1000 Hz Tick Rate
CONFIG_FREERTOS_HZ=1000

# Stack Sizes
CONFIG_ESP_MAIN_TASK_STACK_SIZE=8192
CONFIG_ESP_SYSTEM_EVENT_TASK_STACK_SIZE=4096

# Console
CONFIG_ESP_CONSOLE_UART_DEFAULT=y
CONFIG_ESP_CONSOLE_UART_BAUDRATE=115200

# LVGL Monochrome 1-bit E-Paper Configuration
CONFIG_LV_COLOR_DEPTH_1=y
CONFIG_LV_COLOR_DEPTH=1
CONFIG_LV_MEM_SIZE_KILOBYTES=32
CONFIG_LV_FONT_MONTSERRAT_14=y
CONFIG_LV_FONT_MONTSERRAT_18=y
CONFIG_LV_FONT_MONTSERRAT_28=y
CONFIG_LV_USE_THEME_MONO=y
CONFIG_LV_THEME_DEFAULT_DARK=n
```
